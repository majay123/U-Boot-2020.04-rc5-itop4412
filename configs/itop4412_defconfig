## configs/itop4412_defconfig
```kconfig
CONFIG_ARM=y
CONFIG_ARCH_CPU_INIT=y
CONFIG_ARCH_EXYNOS=y
CONFIG_SYS_TEXT_BASE=0x43E00000
CONFIG_ARCH_EXYNOS4=y
CONFIG_TARGET_ITOP4412=y
CONFIG_SPL=y
CONFIG_SPL_TEXT_BASE=0x02023400
# CONFIG_SPL_FRAMEWORK is not set
CONFIG_IDENT_STRING=" for iTOP4412"
CONFIG_DEFAULT_DEVICE_TREE="exynos4412-itop4412"
CONFIG_SYS_PROMPT="iTOP4412 # "
# CONFIG_CMD_XIMG is not set
CONFIG_DISTRO_DEFAULTS=y
# CONFIG_USE_BOOTCOMMAND is not set
# CONFIG_CMD_IMLS is not set
# CONFIG_CMD_FPGA is not set
# CONFIG_CMD_NET is not set
# CONFIG_CMD_NFS is not set
# CONFIG_CMD_MISC is not set
CONFIG_DEBUG_UART=y
CONFIG_SPL_SERIAL_SUPPORT=y
CONFIG_SPL_GPIO_SUPPORT=y
CONFIG_DEBUG_UART_BASE=0x13820000
CONFIG_DEBUG_UART_CLOCK=100000000
CONFIG_S5P=y
CONFIG_DEBUG_UART_S5P=y
CONFIG_DEBUG_UART_ANNOUNCE=y
CONFIG_CMD_MMC=y
CONFIG_DM_MMC=y
CONFIG_MMC_DW=y
CONFIG_MMC_SDHCI=y
CONFIG_MMC_SDHCI_SDMA=y
CONFIG_MMC_SDHCI_S5P=y
CONFIG_MMC_BROKEN_CD=y
CONFIG_CMD_CACHE=y
CONFIG_CMD_EXT4_WRITE=y
CONFIG_DM=y
CONFIG_USB=y
CONFIG_DM_USB=y
CONFIG_USB_EHCI_EXYNOS=y
CONFIG_CMD_USB=y
CONFIG_CMD_DFU=y
CONFIG_CMD_GPIO=y
CONFIG_DM_ETH=y
CONFIG_BOOTDELAY=5
CONFIG_USB_GADGET=y
CONFIG_USB_GADGET_MANUFACTURER="Samsung"
CONFIG_USB_GADGET_VENDOR_NUM=0x04e8
CONFIG_USB_GADGET_PRODUCT_NUM=0x6601
CONFIG_USB_GADGET_DWC2_OTG=y
CONFIG_USB_GADGET_DOWNLOAD=y
CONFIG_USB_FUNCTION_THOR=y

CONFIG_CMD_LED=y

# LED Support
#
CONFIG_LED=y
CONFIG_LED_BLINK=y
CONFIG_LED_GPIO=y

CONFIG_CMD_BEEP=y
CONFIG_CLK=y
CONFIG_USB_FUNCTION_DFU=y
# CONFIG_DFU_MMC is not set
CONFIG_DM_PWM=y
CONFIG_PWM_EXYNOS=y
# CONFIG_PWM_TEGRA is not set

CONFIG_USB_HOST=y
CONFIG_USB_EHCI_HCD=y
CONFIG_USB_EHCI=y
CONFIG_USB_EHCI_GENERIC=y

CONFIG_USB_STORAGE=y
CONFIG_USB_GADGET=y
CONFIG_USB_GADGET_VBUS_DRAW=2
CONFIG_USB_GADGET_DUALSPEED=y
CONFIG_USB_GADGET_DOWNLOAD=y

CONFIG_G_DNL_MANUFACTURER="samsung"
CONFIG_G_DNL_VENDOR_NUM=0x04E8
CONFIG_G_DNL_PRODUCT_NUM=0x685D
CONFIG_USBNET_DEVADDR="de:ad:be:ef:00:01"
```
